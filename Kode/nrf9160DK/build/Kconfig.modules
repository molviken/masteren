## Kode/nrf9160DK/build_nrf9160_pca10090/Kconfig.modules
```kconfig
osource "C:/Users/oyste/Documents/Masteroppgave/Kode/SDK/ncs/nrf/Kconfig.nrf"

osource "C:/Users/oyste/Documents/Masteroppgave/Kode/SDK/ncs/bootloader/mcuboot/zephyr/Kconfig"

osource "C:/Users/oyste/Documents/Masteroppgave/Kode/SDK/ncs/nrfxlib/Kconfig.nrfxlib"
```
